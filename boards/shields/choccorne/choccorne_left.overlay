// This file was generated from a template. Edit it to match your keyboard.
// See https://zmk.dev/docs/development/hardware-integration/new-shield for more
// instructions.

#include "choccorne.dtsi"

&kscan0 {
    // Replace these comments with the GPIO pins in the matrix for the left side.
    // See https://zmk.dev/docs/development/hardware-integration/new-shield#shield-overlays
    col-gpios
        = <&gpio1 10 GPIO_ACTIVE_HIGH>   //Col0
        , <&gpio1 15 GPIO_ACTIVE_HIGH>   //Col1
        , <&gpio1 14 GPIO_ACTIVE_HIGH>   //Col2
        , <&gpio1 13 GPIO_ACTIVE_HIGH>   //Col3
        , <&gpio1 12 GPIO_ACTIVE_HIGH>   //Col4
        , <&gpio1 11 GPIO_ACTIVE_HIGH>   //Col5
        ;
};
